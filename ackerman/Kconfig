## ackerman/Kconfig
```kconfig
config APP_ACKERMAN
	tristate "4 wheel ackerman car application"
	default n
	---help---
		Enable ackerman application

if APP_ACKERMAN

endif
```

## amrboot/Kconfig
```kconfig
config APP_QTIAMRBOOT
	tristate "QTI AMR bootloader application"
	default n
	---help---
		Enable QTI AMR bootloader application

if APP_QTIAMRBOOT

endif
```
